## Kconfig
```kconfig
# Copyright (c) 2026 Ziemniaczenka
# SPDX-License-Identifier: MIT

menu "ReThink keyboard"

menu "Hardware options"
	comment "Set in config/rethink.conf to match the adapter's jumpers and parts"

choice RETHINK_EXPANDER_SUPPLY
	prompt "PCAL6416A supply (adapter JP10)"
	default RETHINK_EXPANDER_SUPPLY_LED_3V3

config RETHINK_EXPANDER_SUPPLY_LED_3V3
	bool "LED_3V3, always on (JP10 1-2, default)"

config RETHINK_EXPANDER_SUPPLY_TP_3V3
	bool "TP_3V3, switched by P3.12 (JP10 2-3)"
	help
	  TP_3V3 is switched on before the expander is probed and stays on
	  while the adapter is in use.

endchoice

config RETHINK_PUMP_EN_TIED
	bool "Charge pump enable tied to TP_3V3 (adapter JP1 closed)"
	help
	  The pump then runs whenever TP_3V3 is on. The expander leaves P0_0
	  (PUMP_EN) as an input so it does not drive against TP_3V3.

config RETHINK_BOOST_FITTED
	bool "Backlight boost converter U4 fitted"
	default y
	help
	  Fitted on the Full and FFC2 variants, not on Mezz_no_BL and FFC1.
	  Without it the backlight power chain is never switched on.

config RETHINK_BOOST_EN_TIED
	bool "Backlight boost enable tied to VLED_BL (adapter JP2 closed)"
	help
	  The boost then runs whenever the Control Board switches VLED_BL on.
	  The expander leaves P0_1 (BOOST_EN) as an input so it does not drive
	  against VLED_BL.

choice RETHINK_BACKLIGHT_SUPPLY
	prompt "VLED_BL source on the Control Board"
	default RETHINK_BACKLIGHT_SUPPLY_BUCK1

config RETHINK_BACKLIGHT_SUPPLY_BUCK1
	bool "nPM1300 BUCK1, 3.3 V (R62 fitted, default)"
	help
	  BUCK1 is switched on with the backlight. The nPM1300 bucks deliver
	  up to 200 mA.

config RETHINK_BACKLIGHT_SUPPLY_VBAT
	bool "Battery, VBAT (R59 fitted, R62 removed; Control Board rev. 1)"
	help
	  BUCK1 stays off. Without a battery there is no backlight, also on
	  USB. The current bypasses the nPM1300's system path.

config RETHINK_BACKLIGHT_SUPPLY_VSYS
	bool "nPM1300 VSYS (expected on the next Control Board revision)"
	help
	  BUCK1 stays off. VSYS is fed from USB or the battery, so the
	  backlight works in both cases and its current goes through the
	  nPM1300 like any other load (VBUS limit 500 mA).

endchoice

config RETHINK_BACKLIGHT_MAX_DUTY
	int "PWM duty cycle at full brightness (%)"
	range 1 10
	default 10
	help
	  Scales every brightness level to limit the backlight current drawn
	  from VLED_BL. Capped at 10 % until real keyboards are measured: on
	  BUCK1 the adapter's boost runs cleanly at 50 mA and fails at about
	  106 mA.

config RETHINK_MCUBOOT_NEEDS_POWER_CYCLE
	bool "Bootloader checks its button only after a power-on reset"
	default y
	help
	  True for the factory MCUboot on the first Control Boards: Framework's
	  daisy branch before commit c4a29622f1 (2026-10-16) skips the
	  recovery button after a soft reset. The pairing button's recovery
	  hold then power-cycles the board through the nPM1300 instead of a
	  soft reset. Set n for boards with a newer bootloader.

choice RETHINK_TP1_SUPPLY
	prompt "Mezzanine/FFC1 pointing stick supply (adapter JP6, JP4, JP5)"
	default RETHINK_TP1_SUPPLY_5V
	help
	  Used by the TrackPoint support. JP4 and JP5 must match JP6.

config RETHINK_TP1_SUPPLY_5V
	bool "5 V from the charge pump, through the level shifter (default)"

config RETHINK_TP1_SUPPLY_3V3
	bool "TP_3V3, level shifter bypassed"

endchoice

choice RETHINK_TP2_SUPPLY
	prompt "FFC2 pointing stick supply (adapter JP7, JP8, JP9)"
	default RETHINK_TP2_SUPPLY_3V3
	help
	  Used by the TrackPoint support. JP8 and JP9 must match JP7.

config RETHINK_TP2_SUPPLY_3V3
	bool "TP_3V3, level shifter bypassed (default)"

config RETHINK_TP2_SUPPLY_5V
	bool "5 V from the charge pump, through the level shifter"

endchoice

choice RETHINK_TP2_RESET_PULL
	prompt "FFC2 pointing stick reset resistor"
	default RETHINK_TP2_RESET_PULL_UP
	help
	  Used by the TrackPoint support. The Mezzanine/FFC1 reset (TP1_RST)
	  only has the R14 pull-up.

config RETHINK_TP2_RESET_PULL_UP
	bool "Pull-up R22: held in reset until released (default)"

config RETHINK_TP2_RESET_PULL_DOWN
	bool "Pull-down R23: running unless reset is driven"

endchoice

endmenu

config RETHINK_PAIRING_BUTTON
	bool "Pairing button selects and clears Bluetooth profiles"
	default y
	depends on ZMK_BLE
	depends on $(dt_nodelabel_enabled,pairing_button)
	select INPUT
	# ZMK_POINTING defaults it to n
	select INPUT_GPIO_KEYS
	select REBOOT
	help
	  Tap: next Bluetooth profile. Hold, then release: clear the active
	  profile's bond. Both only while Bluetooth is on (mode switch).
	  Triple tap: unlock the backlight (RETHINK_BACKLIGHT). Long hold:
	  reboot into MCUboot USB recovery.
	  Reads Framework's pairing_button gpio-keys node, outside the key
	  matrix. Holding it while plugging in USB still enters MCUboot recovery.

config RETHINK_PAIRING_BUTTON_HOLD_MS
	int "Hold time to clear the active profile (ms)"
	default 3000
	depends on RETHINK_PAIRING_BUTTON
	help
	  The bond is cleared when the button is released after this time,
	  but before RETHINK_PAIRING_BUTTON_RECOVERY_MS.

config RETHINK_PAIRING_BUTTON_RECOVERY_MS
	int "Hold time to reboot into the bootloader (ms, 0 = off)"
	default 10000
	depends on RETHINK_PAIRING_BUTTON
	help
	  Resets while the button is still held, so MCUboot sees it and
	  enters USB serial recovery. Needed with a battery connected, where
	  plugging in USB does not reset the board. With
	  RETHINK_MCUBOOT_NEEDS_POWER_CYCLE this is an nPM1300 reset (power
	  cycle), otherwise a soft reset.

config RETHINK_PAIRING_BUTTON_TAP_WINDOW_MS
	int "Maximum gap between taps of a multi-tap (ms)"
	default 400
	depends on RETHINK_PAIRING_BUTTON
	help
	  A single tap acts after this delay, once no second tap followed.

config RETHINK_PROFILE_LEDS
	bool "Show the active Bluetooth profile on the white LEDs"
	default y
	depends on ZMK_BLE
	depends on $(dt_nodelabel_enabled,led_w1)
	help
	  Lights white LED 1-4 for the active profile after boot and on every
	  profile change, blinking while the profile is unpaired. Drives the
	  pins as GPIOs, so PWM20 must stay unused (CONFIG_PWM not enabled).

config RETHINK_PROFILE_LEDS_TIMEOUT_MS
	int "Time the profile LED stays on (ms)"
	default 3000
	depends on RETHINK_PROFILE_LEDS

config RETHINK_CONNECTED_LED
	bool "Light the blue LED for a while after connecting"
	default y
	depends on ZMK_BLE || ZMK_USB
	depends on $(dt_nodelabel_enabled,led_b)
	depends on !FRAMEWORK_CB_STATUS_LED
	help
	  Lights the blue LED when a host connects over USB or on the active
	  Bluetooth profile, and on switching to a profile that is connected.
	  It goes off after RETHINK_CONNECTED_LED_TIMEOUT_MS or on
	  disconnecting. Replaces framework-cb's FRAMEWORK_CB_STATUS_LED (on
	  while connected), which the rethink shields default to n.

config RETHINK_CONNECTED_LED_TIMEOUT_MS
	int "Time the blue LED stays on (ms)"
	default 3000
	depends on RETHINK_CONNECTED_LED

config RETHINK_WIRED_OFF
	bool "Power off in wired mode while USB is unplugged"
	default y
	depends on ZMK_USB
	depends on $(dt_nodelabel_enabled,protocol_switch)
	depends on $(dt_nodelabel_enabled,pairing_button)
	# Reads the mode switch (gpio-keys), which ZMK_POINTING defaults to n
	select INPUT_GPIO_KEYS
	select POWEROFF
	select PM_DEVICE
	help
	  With the mode switch on USB and no USB power, the keyboard switches
	  off its LEDs and backlight and enters System OFF. Only plugging in
	  USB or moving the switch to Bluetooth wakes it; keys and the pairing
	  button are ignored so stray presses don't drain the battery.

config RETHINK_WIRED_OFF_DELAY_MS
	int "Delay before powering off (ms)"
	default 3000
	depends on RETHINK_WIRED_OFF
	help
	  Also covers the time USB needs to report VBUS after boot.

DT_COMPAT_RETHINK_ADAPTER_CTRL := rethink,adapter-ctrl

config RETHINK_ADAPTER
	bool "ReThink adapter control (PCAL6416A)"
	default $(dt_compat_enabled,$(DT_COMPAT_RETHINK_ADAPTER_CTRL))
	select I2C
	select GPIO
	select REGULATOR
	help
	  Probes the adapter's PCAL6416A and drives its status LED, charge
	  pump and boost pins. Without the adapter it logs a warning and
	  carries on.

if RETHINK_ADAPTER

config RETHINK_ADAPTER_INIT_PRIORITY
	int "Init priority"
	default 90
	help
	  After I2C and regulator-fixed (REGULATOR_FIXED_INIT_PRIORITY).

config RETHINK_ADAPTER_LED_SELFTEST
	bool "Light each status LED in turn at boot"

config RETHINK_ADAPTER_TEST
	bool "Adapter bring-up shell commands"
	depends on SHELL
	select PM_DEVICE
	help
	  The "adapter" shell command, for an adapter without a keyboard:
	  supplies and enables one at a time, expander pins, the INT line and
	  a test for shorts between the lines to the keyboard connectors. The
	  rethink-usb-shell snippet enables it.

module = RETHINK_ADAPTER
module-str = ReThink adapter
source "subsys/logging/Kconfig.template.log_config"

endif # RETHINK_ADAPTER

DT_COMPAT_RETHINK_MATRIX := rethink,matrix

config RETHINK_MATRIX
	bool "ReThink keyboard matrix"
	default $(dt_compat_enabled,$(DT_COMPAT_RETHINK_MATRIX))
	depends on INPUT
	select GPIO
	select PM_DEVICE
	select ZMK_DEBOUNCE
	help
	  The rethink,matrix input device: ZMK's GPIO matrix plus columns and
	  direct keys on the adapter's expander and ghost-key blocking.

if RETHINK_MATRIX

module = RETHINK_MATRIX
module-str = ReThink matrix
source "subsys/logging/Kconfig.template.log_config"

endif # RETHINK_MATRIX

DT_COMPAT_RETHINK_TRACKPOINT := rethink,trackpoint

config RETHINK_TRACKPOINT
	bool "Pointing stick on the adapter (PS/2)"
	default $(dt_compat_enabled,$(DT_COMPAT_RETHINK_TRACKPOINT))
	depends on RETHINK_ADAPTER
	select GPIO
	select INPUT
	select POLL
	select REGULATOR
	help
	  Power, reset, PS/2 link and pointing of the rethink,trackpoint stick.
	  The link is bit-banged: an interrupt on each falling clock edge. The
	  stick starts after boot and reports movement and buttons as input
	  events (zmk,input-listener, ZMK_POINTING). Without an answer from a
	  stick it is powered off again. Keys: &tp (rethink,behavior-trackpoint).

if RETHINK_TRACKPOINT

config RETHINK_TRACKPOINT_IDLE_OFF_MIN
	int "Minutes unused before the stick is powered off"
	default 10
	range 0 1440
	help
	  Neither the stick nor a key used for this long: the stick is powered
	  off (about 19 mA from the battery with a 5 V T420 stick). The next
	  key press starts it again, which takes about a second. 0 keeps it
	  on. &tp TP_OFF switches it off until &tp TP_ON.

config RETHINK_TRACKPOINT_SAMPLE_RATE
	int "Reports per second"
	default 80
	help
	  PS/2 sample rate: 10, 20, 40, 60, 80, 100 or 200. Battery current
	  with a T420 stick, still: 19.1 mA at 40 and 80/s, 20.3 at 10 and
	  20/s, 20.5 at 100 and 200/s, 21.7 at 60/s. At 200/s its packets
	  still came 10 ms apart. "tp set rate" and &tp TP_RATE_UP/TP_RATE_DN
	  change it; the new rate is kept in flash.

config RETHINK_TRACKPOINT_SLOW_IDLE
	bool "80 reports per second while the stick is still (experimental)"
	help
	  After 2 s without movement the stick reports at 80/s; its first
	  movement packet brings the set rate back, with about 10 ms without
	  packets while it changes. For rates that measure the force more
	  often than 80/s per the TrackPoint specification (60, 100, 200).
	  With a T420 stick at 100/s: 19.1 instead of 20.5 mA while still.
	  For sticks where a faster rate is worth having.

config RETHINK_TRACKPOINT_SENSITIVITY
	int "Sensitivity"
	default 192
	range 0 255
	help
	  The stick's force scale before its transfer function: 128 is x1.0,
	  0-255 is x0 to x1.99; 192 is x1.5. The stick's power-on value is 128
	  (the TrackPoint specification, and Linux). Written to the stick after
	  each start; "tp set sensitivity" changes it and keeps it in flash.

config RETHINK_TRACKPOINT_NEG_INERTIA
	int "Negative inertia"
	default 6
	range 0 255
	help
	  Boosts changes of force, so the pointer starts and stops more
	  sharply; 0 is off. Power-on value 6. IBM sticks only (TrackPoint ID
	  01, the T420's), as are the speed and drift time.

config RETHINK_TRACKPOINT_SPEED
	int "Upper plateau speed"
	default 150
	range 0 255
	help
	  Pointer speed under a firm push: about 22 + 4.3 x this counts a
	  second (667 at 150, 439 at the power-on value 97).

config RETHINK_TRACKPOINT_DRIFT_TIME
	int "Drift correction time"
	default 10
	range 1 255
	help
	  Hands off for this long, in 107 ms steps, and the stick takes the
	  present forces as its zero point. Power-on value 5 (0.53 s).

config RETHINK_TRACKPOINT_PRESS_TO_SELECT
	bool "Press-to-select"
	help
	  Pressing the stick clicks. Off at power-on. &tp TP_PTS_TOG switches
	  it (Alt+Fn+F8 on the T420 and L420).

config RETHINK_TRACKPOINT_SCROLL
	bool "Middle button held: the stick scrolls"
	default y
	help
	  While the middle button is held, movement turns into the wheel:
	  each report's stronger axis, vertical, or sideways once that passes
	  RETHINK_TRACKPOINT_SCROLL_H_DEAD_ZONE. Letting the middle button go
	  clicks it only if the stick didn't move. "tp set scroll_divisor" and
	  "tp set scroll_dead_zone" change the numbers and keep them in flash.
	  Turns on ZMK_POINTING_SMOOTH_SCROLLING:
	  the wheel in sixteenths of a step for hosts that set the HID
	  Resolution Multiplier, whole steps for others.

config RETHINK_TRACKPOINT_SCROLL_DIVISOR
	int "Stick counts per wheel step"
	default 20
	range 1 255
	depends on RETHINK_TRACKPOINT_SCROLL
	help
	  Larger scrolls slower. One wheel step is usually three lines.

config RETHINK_TRACKPOINT_SCROLL_H_DEAD_ZONE
	int "Sideways counts per report that don't scroll"
	default 2
	range 0 127
	depends on RETHINK_TRACKPOINT_SCROLL
	help
	  Horizontal scrolling only for a report with more sideways counts
	  than this, and only from the excess, so a push up that leans a
	  little doesn't scroll sideways. A report with more vertical than
	  sideways counts scrolls only vertically.

config RETHINK_TRACKPOINT_INIT_PRIORITY
	int "Init priority"
	default 92
	help
	  After RETHINK_ADAPTER_INIT_PRIORITY.

config RETHINK_TRACKPOINT_THREAD_STACK_SIZE
	int "Thread stack size"
	default 1024
	help
	  The thread starts the stick after boot, then reports its packets.

config RETHINK_TRACKPOINT_THREAD_PRIORITY
	int "Thread priority"
	default 5

config RETHINK_TRACKPOINT_SHELL
	bool "tp shell commands"
	default y
	depends on SHELL
	help
	  Power the stick, send it bytes and show what it sends, with link
	  error counters and its clock period. The rethink-usb-shell snippet
	  provides the shell.

module = RETHINK_TRACKPOINT
module-str = ReThink pointing stick
source "subsys/logging/Kconfig.template.log_config"

endif # RETHINK_TRACKPOINT

config RETHINK_BLE_SHELL
	bool "ble shell commands"
	default y
	depends on SHELL && ZMK_BLE
	help
	  "ble conn" shows the Bluetooth connection interval the host chose and
	  asks it for another. The rethink-usb-shell snippet provides the
	  shell.

DT_COMPAT_RETHINK_BACKLIGHT := rethink,backlight

config RETHINK_BACKLIGHT
	bool "ReThink backlight power chain and PWM"
	default $(dt_compat_enabled,$(DT_COMPAT_RETHINK_BACKLIGHT))
	select LED
	select PWM
	select GPIO
	select REGULATOR

if RETHINK_BACKLIGHT

config RETHINK_BACKLIGHT_INIT_PRIORITY
	int "Init priority"
	default 91
	help
	  After RETHINK_ADAPTER_INIT_PRIORITY and the nPM13xx regulators
	  (REGULATOR_NPM13XX_INIT_PRIORITY).

module = RETHINK_BACKLIGHT
module-str = ReThink backlight
source "subsys/logging/Kconfig.template.log_config"

endif # RETHINK_BACKLIGHT

endmenu
```

## boards/shields/rethink_bare_tester/Kconfig.defconfig
```kconfig
# Copyright (c) 2026 Ziemniaczenka
# SPDX-License-Identifier: MIT

if SHIELD_RETHINK_BARE_TESTER

config ZMK_KEYBOARD_NAME
    default "ReThink Tester"

endif # SHIELD_RETHINK_BARE_TESTER
```

## boards/shields/rethink_bare_tester/Kconfig.shield
```kconfig
# SPDX-License-Identifier: MIT

config SHIELD_RETHINK_BARE_TESTER
    def_bool $(shields_list_contains,rethink_bare_tester)
```

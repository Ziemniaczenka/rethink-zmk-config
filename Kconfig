## boards/shields/rethink_e580/Kconfig.defconfig
```kconfig
# Copyright (c) 2026 Ziemniaczenka
# SPDX-License-Identifier: MIT

if SHIELD_RETHINK_E580

config ZMK_KEYBOARD_NAME
    default "ReThink E580"

endif # SHIELD_RETHINK_E580
```

## boards/shields/rethink_e580/Kconfig.shield
```kconfig
# Copyright (c) 2026 Ziemniaczenka
# SPDX-License-Identifier: MIT

config SHIELD_RETHINK_E580
    def_bool $(shields_list_contains,rethink_e580)
```

## boards/shields/rethink_hw_tester/Kconfig.shield
```kconfig
# Copyright (c) 2026 Ziemniaczenka
# SPDX-License-Identifier: MIT

config SHIELD_RETHINK_HW_TESTER
    def_bool $(shields_list_contains,rethink_hw_tester)
```

## boards/shields/rethink_l420/Kconfig.defconfig
```kconfig
# Copyright (c) 2026 Ziemniaczenka
# SPDX-License-Identifier: MIT

if SHIELD_RETHINK_L420

config ZMK_KEYBOARD_NAME
    default "ReThink L420"

endif # SHIELD_RETHINK_L420
```

## boards/shields/rethink_l420/Kconfig.shield
```kconfig
# Copyright (c) 2026 Ziemniaczenka
# SPDX-License-Identifier: MIT

config SHIELD_RETHINK_L420
    def_bool $(shields_list_contains,rethink_l420)
```

## boards/shields/rethink_scanner/Kconfig.defconfig
```kconfig
# Copyright (c) 2026 Ziemniaczenka
# SPDX-License-Identifier: MIT

if SHIELD_RETHINK_SCANNER

config ZMK_KEYBOARD_NAME
    default "ReThink Scanner"

endif # SHIELD_RETHINK_SCANNER
```

## boards/shields/rethink_scanner/Kconfig.shield
```kconfig
# Copyright (c) 2026 Ziemniaczenka
# SPDX-License-Identifier: MIT

config SHIELD_RETHINK_SCANNER
    def_bool $(shields_list_contains,rethink_scanner)
```

## boards/shields/rethink_t420/Kconfig.defconfig
```kconfig
# Copyright (c) 2026 Ziemniaczenka
# SPDX-License-Identifier: MIT

if SHIELD_RETHINK_T420

config ZMK_KEYBOARD_NAME
    default "ReThink T420"

endif # SHIELD_RETHINK_T420
```

## boards/shields/rethink_t480/Kconfig.defconfig
```kconfig
# Copyright (c) 2026 Ziemniaczenka
# SPDX-License-Identifier: MIT

if SHIELD_RETHINK_T480

config ZMK_KEYBOARD_NAME
    default "ReThink T480"

endif # SHIELD_RETHINK_T480
```

## boards/shields/rethink_t480/Kconfig.shield
```kconfig
# Copyright (c) 2026 Ziemniaczenka
# SPDX-License-Identifier: MIT

config SHIELD_RETHINK_T480
    def_bool $(shields_list_contains,rethink_t480)
```

## dts/bindings/rethink,adapter-ctrl.yaml
```yaml
# Copyright (c) 2026 Ziemniaczenka
# SPDX-License-Identifier: MIT

description: |
  ReThink adapter control: brings up the PCAL6416A I/O expander (U1) and owns
  its pins. Other code uses them through include/rethink/adapter.h, or
  register by register through include/rethink/expander.h.

  The expander is optional at runtime and is probed at init. If it does not
  answer, a warning is logged and the board keeps working without it. With
  CONFIG_RETHINK_EXPANDER_SUPPLY_TP_3V3 (JP10 2-3) U1 and its I2C pull-ups
  run from TP_3V3, which is then enabled first.

  Assembly options (jumpers, fitted parts) are Kconfig symbols, set in
  config/rethink.conf. The properties below describe the wiring; shields only
  list the LEDs and detect pin their keyboard has.

compatible: "rethink,adapter-ctrl"

properties:
  expander:
    type: phandle
    required: true
    description: PCAL6416A node (rethink,pcal6416a).

  tp-power-supply:
    type: phandle
    description: Regulator for TP_3V3 (Control Board P3.12).

  power-on-delay-ms:
    type: int
    default: 10
    description: Time between enabling tp-power-supply and probing the expander.

  pump-en-gpios:
    type: phandle-array
    description: |
      LM2775 charge pump enable (TP_5V). Driven low at init, unless
      CONFIG_RETHINK_PUMP_EN_TIED (JP1 closed).

  boost-en-gpios:
    type: phandle-array
    description: |
      TPS610333 backlight boost enable (BL_5V). Driven low at init, unless
      CONFIG_RETHINK_BOOST_EN_TIED (JP2 closed).

  idle-gpios:
    type: phandle-array
    description: |
      Expander pins that nothing else drives, each with the pull it rests on
      (GPIO_PULL_UP or GPIO_PULL_DOWN). Set as inputs at init and before
      System OFF, then the pins of the properties above and below are set up
      as those describe, so the list may include them. A floating input draws
      up to 80 µA. A pin pulled up externally to a supply that can be off
      floats with that supply: give it GPIO_PULL_DOWN (TP1_RST, TP2_RST).
      Leave out pins a jumper may tie to a supply (PUMP_EN, BOOST_EN).

  bl-detect-gpios:
    type: phandle-array
    description: |
      KBD_BL_DTCT. Sampled once at init with the pull-up enabled; low means a
      backlit keyboard is connected. The pull-up then stays on, unless the
      keyboard holds the pin low.

  # Status LED sinks. A lit LED pulls the pin low; an unlit one rests on the
  # pull-up (open-drain emulation: only the direction register changes, one
  # 1-byte write). Pin flags are ignored.
  pwr-led-gpios:
    type: phandle-array
    description: LEDPWR, power LED (Mezzanine) or Fn lock LED (FFC2).

  mute-led-gpios:
    type: phandle-array
    description: LEDMUTE

  micmute-led-gpios:
    type: phandle-array
    description: LEDMICMUTE

  capslock-led-gpios:
    type: phandle-array
    description: LEDCPSLOCK

  numlock-led-gpios:
    type: phandle-array
    description: LEDNUMLOCK (FFC2 keyboards with a numpad)
```

## dts/bindings/rethink,backlight.yaml
```yaml
# Copyright (c) 2026 Ziemniaczenka
# SPDX-License-Identifier: MIT

description: |
  ReThink keyboard backlight: LED API device for ZMK's zmk,backlight.

  Power chain, switched on only while the brightness is above zero:
  vin-supply (nPM1300 BUCK1) -> enable-gpios (Control Board P3.11, VLED_BL to
  the adapter) -> adapter boost converter (BOOST_EN, through
  rethink,adapter-ctrl). The duty cycle on pwms (P1.17) is the brightness
  scaled by CONFIG_RETHINK_BACKLIGHT_MAX_DUTY.

  vin-supply is only switched with CONFIG_RETHINK_BACKLIGHT_SUPPLY_BUCK1. With
  CONFIG_RETHINK_BOOST_FITTED=n the chain is never switched on.

  Safety interlock: the chain stays off unless the adapter detected a backlit
  keyboard (KBD_BL_DTCT low) or the user unlocked it with
  rethink_backlight_unlock() (triple press of the pairing button).

compatible: "rethink,backlight"

properties:
  pwms:
    type: phandle-array
    required: true

  enable-gpios:
    type: phandle-array
    description: Control Board switch feeding VLED_BL to the adapter (P3.11).

  vin-supply:
    type: phandle
    description: Regulator behind enable-gpios (nPM1300 BUCK1, default source).

  power-on-delay-ms:
    type: int
    default: 5
    description: Settling time after switching the power chain on, before PWM starts.

child-binding:
  description: One backlight channel. ZMK counts the children of zmk,backlight.
  properties:
    label:
      type: string
```

## dts/bindings/rethink,behavior-trackpoint.yaml
```yaml
# Copyright (c) 2026 Ziemniaczenka
# SPDX-License-Identifier: MIT

description: |
  Pointing stick (rethink,trackpoint) from a key: &tp TP_OFF, TP_ON, TP_TOG,
  TP_RECAL, TP_RATE_UP, TP_RATE_DN or TP_PTS_TOG, from
  dt-bindings/rethink/trackpoint.h.
  The stick's thread carries the request out, so the key doesn't wait for
  the stick.

compatible: "rethink,behavior-trackpoint"

include: one_param.yaml
```

## dts/bindings/rethink,matrix.yaml
```yaml
# Copyright (c) 2026 Ziemniaczenka
# SPDX-License-Identifier: MIT

description: |
  Keyboard matrix for ThinkPad keyboards on the ReThink adapter, based on
  ZMK's zmk,input-gpio-matrix. Columns are driven active one at a time and
  the rows read (col2row). It reports the same input events (INPUT_ABS_X =
  column, INPUT_ABS_Y = row, INPUT_BTN_TOUCH), so it serves as
  zmk,matrix-input.

  Additions:
  - Columns on the adapter's expander (expander-col-gpios), numbered after
    the Control Board columns. They are switched like open-drain outputs,
    driven low or released to U1's pull-up, each step one 1-byte I2C write.
  - Direct keys on the expander (direct-gpios), inputs that a key pulls to
    GND, reported as one extra row after the last matrix row. U1's INT line
    (int-gpios) wakes the matrix when one changes.
  - Ghost-key blocking for diodeless matrices: where pressed keys form a
    rectangle, the keys in it keep their state until the rectangle breaks.

  Without the adapter the expander columns and direct keys stay silent and
  the rest of the matrix works.

compatible: "rethink,matrix"

include: base.yaml

properties:
  row-gpios:
    type: phandle-array
    required: true
    description: Rows, read. ThinkPad matrices pull them up (GPIO_ACTIVE_LOW | GPIO_PULL_UP).

  col-gpios:
    type: phandle-array
    required: true
    description: |
      Control Board columns, driven active one at a time. GPIO_OPEN_DRAIN
      for diodeless matrices, so an inactive column doesn't drive against
      an active one through two pressed keys.

  expander-col-gpios:
    type: phandle-array
    description: Columns on the expander, <&rethink_expander pin 0>. Active low.

  direct-gpios:
    type: phandle-array
    description: Expander inputs pulled to GND by a key, <&rethink_expander pin 0>.

  int-gpios:
    type: phandle-array
    description: Control Board pin with the expander's INT. Required with direct-gpios.

  ghost-key-blocking:
    type: boolean
    description: Block presses that complete a rectangle of pressed keys.

  settle-us:
    type: int
    default: 5
    description: |
      Wait after switching a column before reading the rows. A released
      open-drain column recovers through the row pull-ups, slower than a
      driven one.

  debounce-press-ms:
    type: int
    default: 5

  debounce-release-ms:
    type: int
    default: 5

  debounce-scan-period-ms:
    type: int
    default: 1
    description: Time between scans while any key is pressed.
```

## dts/bindings/rethink,pcal6416a.yaml
```yaml
# Copyright (c) 2026 Ziemniaczenka
# SPDX-License-Identifier: MIT

description: |
  PCAL6416A I/O expander (U1) on the ReThink adapter. No Zephyr GPIO driver
  binds to it: rethink,adapter-ctrl drives its registers directly
  (src/expander.c) and writes only the bytes that change, so a matrix column
  or status LED costs a single 1-byte I2C write. The node keeps the GPIO
  specifier format, so other nodes name its pins as
  <&rethink_expander pin flags>; flags only carry the idle pulls. It is not
  marked gpio-controller, since nothing provides a GPIO device for it (the
  gpio shell would look for one).

compatible: "rethink,pcal6416a"

include: i2c-device.yaml

properties:
  "#gpio-cells":
    type: int
    const: 2

gpio-cells:
  - pin
  - flags
```

## dts/bindings/rethink,trackpoint.yaml
```yaml
# Copyright (c) 2026 Ziemniaczenka
# SPDX-License-Identifier: MIT

description: |
  Pointing stick (TrackPoint) on the ReThink adapter: its power, its reset
  and the PS/2 link to it.

  TP1 (Mezzanine, FFC1) and TP2 (FFC2) share the Control Board's FW_CLK and
  FW_DAT lines; the jumpers and Kconfig symbols in config/rethink.conf choose
  each one's supply (RETHINK_TP1_SUPPLY_*, RETHINK_TP2_SUPPLY_*). On 5 V the
  charge pump runs while the stick is powered. The reset is active high and
  a resistor to the stick's supply holds it in reset until the expander
  drives it low (TP2 with R23: running unless driven high).

compatible: "rethink,trackpoint"

properties:
  clk-gpios:
    type: phandle-array
    required: true
    description: FW_CLK (P1.16), open-drain, R6 pull-up to TP_3V3.

  data-gpios:
    type: phandle-array
    required: true
    description: FW_DAT (P1.15), open-drain, R7 pull-up to TP_3V3.

  reset-gpios:
    type: phandle-array
    required: true
    description: TP1_RST or TP2_RST on the expander (rethink_expander).

  power-supply:
    type: phandle
    required: true
    description: Regulator for TP_3V3 (Control Board P3.12).

  tp2:
    type: boolean
    description: The FFC2 stick (TP2) instead of TP1.

  reset-ms:
    type: int
    default: 600
    description: |
      Time the reset is held after power is applied. The TrackPoint
      specification times its power-on reset at 600 ms +-20 %.
```

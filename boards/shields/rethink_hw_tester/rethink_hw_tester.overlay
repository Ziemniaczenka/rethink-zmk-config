/*
 * Copyright (c) 2026 Ziemniaczenka
 * SPDX-License-Identifier: MIT
 *
 * Adapter hardware tester: the ReThink adapter (PCAL6416A, status LEDs,
 * backlight power chain and PWM on P1.17) and its whole matrix, 8x18 plus
 * HOTKEY and PWRSWITCH. Runs on a bare Control Board too: the adapter is
 * reported missing, the Control Board part of the matrix still works on the
 * header, and the Control Board side of the backlight chain can be measured.
 */

#include "../rethink_common/rethink_cb.dtsi"
#include "../rethink_common/rethink_adapter.dtsi"
#include "../rethink_common/rethink_backlight.dtsi"
#include "../rethink_common/rethink_adapter_matrix.dtsi"

// Everything an FFC2 keyboard with a numpad (T580, L15) has
&rethink_adapter {
    bl-detect-gpios = <&rethink_expander RETHINK_EXP_KBD_BL_DTCT GPIO_ACTIVE_LOW>;
    pwr-led-gpios = <&rethink_expander RETHINK_EXP_LEDPWR 0>;
    mute-led-gpios = <&rethink_expander RETHINK_EXP_LEDMUTE 0>;
    micmute-led-gpios = <&rethink_expander RETHINK_EXP_LEDMICMUTE 0>;
    capslock-led-gpios = <&rethink_expander RETHINK_EXP_LEDCPSLOCK 0>;
    numlock-led-gpios = <&rethink_expander RETHINK_EXP_LEDNUMLOCK 0>;
};

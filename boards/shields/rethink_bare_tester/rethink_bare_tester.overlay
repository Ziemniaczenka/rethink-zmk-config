/*
 * Copyright (c) 2026 Ziemniaczenka
 * SPDX-License-Identifier: MIT
 *
 * Bare Control Board tester: no ReThink adapter needed.
 *
 * Header matrix (see rethink_header_matrix.dtsi). The pairing button and the
 * USB/Bluetooth switch stay outside the matrix as Framework's gpio-keys (see
 * src/pairing_button.c and framework-cb's mode_switch.c).
 */

#include "../rethink_common/rethink_cb.dtsi"
#include "../rethink_common/rethink_header_matrix.dtsi"

// No backlight on this shield
&pwm22 {
    status = "disabled";
};

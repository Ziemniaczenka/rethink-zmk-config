/*
 * Copyright (c) 2026 Ziemniaczenka
 * SPDX-License-Identifier: MIT
 *
 * The whole matrix the adapter carries: SENSE0-7 (P0.00-P0.07) by DRV0-14
 * (Control Board) and DRV15-17 (expander P0_4-P0_6), plus HOTKEY and
 * PWRSWITCH (expander P0_2, P0_3) as direct keys in row 8. Columns are
 * open-drain and ghost keys are blocked, for diodeless ThinkPad matrices.
 * In a matrix transform, row r is SENSEr and column c is DRVc; HOTKEY and
 * PWRSWITCH are RC(8,0) and RC(8,1).
 *
 * Include after rethink_adapter.dtsi, then a physical layout: the keyboard
 * shield's own, or rethink_adapter_full_layout.dtsi. KSO15/16 (P1.15/P1.16)
 * are the TrackPoint PS/2 lines and KSO17 (P1.17) the backlight PWM, so
 * DRV15-17 come from the expander instead.
 */

/ {
    chosen {
        zmk,matrix-input = &matrix;
    };

    matrix: matrix {
        compatible = "rethink,matrix";
        wakeup-source;
        ghost-key-blocking;

        // SENSE0-7 / KSI0-7
        row-gpios
            = <&gpio0 0 (GPIO_ACTIVE_LOW | GPIO_PULL_UP)>
            , <&gpio0 1 (GPIO_ACTIVE_LOW | GPIO_PULL_UP)>
            , <&gpio0 2 (GPIO_ACTIVE_LOW | GPIO_PULL_UP)>
            , <&gpio0 3 (GPIO_ACTIVE_LOW | GPIO_PULL_UP)>
            , <&gpio0 4 (GPIO_ACTIVE_LOW | GPIO_PULL_UP)>
            , <&gpio0 5 (GPIO_ACTIVE_LOW | GPIO_PULL_UP)>
            , <&gpio0 6 (GPIO_ACTIVE_LOW | GPIO_PULL_UP)>
            , <&gpio0 7 (GPIO_ACTIVE_LOW | GPIO_PULL_UP)>
            ;

        // DRV0-14 / KSO0-14
        col-gpios
            = <&gpio1 0 (GPIO_ACTIVE_LOW | GPIO_OPEN_DRAIN)>
            , <&gpio1 1 (GPIO_ACTIVE_LOW | GPIO_OPEN_DRAIN)>
            , <&gpio1 18 (GPIO_ACTIVE_LOW | GPIO_OPEN_DRAIN)>
            , <&gpio1 19 (GPIO_ACTIVE_LOW | GPIO_OPEN_DRAIN)>
            , <&gpio1 4 (GPIO_ACTIVE_LOW | GPIO_OPEN_DRAIN)>
            , <&gpio1 5 (GPIO_ACTIVE_LOW | GPIO_OPEN_DRAIN)>
            , <&gpio1 6 (GPIO_ACTIVE_LOW | GPIO_OPEN_DRAIN)>
            , <&gpio1 7 (GPIO_ACTIVE_LOW | GPIO_OPEN_DRAIN)>
            , <&gpio1 8 (GPIO_ACTIVE_LOW | GPIO_OPEN_DRAIN)>
            , <&gpio1 9 (GPIO_ACTIVE_LOW | GPIO_OPEN_DRAIN)>
            , <&gpio1 10 (GPIO_ACTIVE_LOW | GPIO_OPEN_DRAIN)>
            , <&gpio1 11 (GPIO_ACTIVE_LOW | GPIO_OPEN_DRAIN)>
            , <&gpio1 12 (GPIO_ACTIVE_LOW | GPIO_OPEN_DRAIN)>
            , <&gpio1 13 (GPIO_ACTIVE_LOW | GPIO_OPEN_DRAIN)>
            , <&gpio1 14 (GPIO_ACTIVE_LOW | GPIO_OPEN_DRAIN)>
            ;

        // DRV15-17, columns 15-17
        expander-col-gpios
            = <&rethink_expander 4 0>
            , <&rethink_expander 5 0>
            , <&rethink_expander 6 0>
            ;

        // HOTKEY, PWRSWITCH: row 8, columns 0 and 1
        direct-gpios
            = <&rethink_expander 2 0>
            , <&rethink_expander 3 0>
            ;

        // TP_INT: U1's open-drain INT, R3 pull-up on the adapter
        int-gpios = <&gpio3 6 GPIO_ACTIVE_LOW>;
    };
};
